/* Copyright (c) 2012-2014, The Linux Foundation. All rights reserved.
 *
 * This program is free software; you can redistribute it and/or modify
 * it under the terms of the GNU General Public License version 2 and
 * only version 2 as published by the Free Software Foundation.
 *
 * This program is distributed in the hope that it will be useful,
 * but WITHOUT ANY WARRANTY; without even the implied warranty of
 * MERCHANTABILITY or FITNESS FOR A PARTICULAR PURPOSE.  See the
 * GNU General Public License for more details.
 */


/*
 * Board voltage overrides from the working Martini tree. Keep the regulator
 * topology and Krait driver properties supplied by this kernel's base DTS.
 * Do not propagate the reference's unverified 150000 uV S2 initialization.
 * Leave S2 at the base DTS setting of 2150000 uV.
 */
&pm8941_s3 {
	/* S3A feeds N2182 AVDD (1.65-1.95 V) as well as digital I/O. */
	regulator-max-microvolt = <1800000>;
	qcom,init-voltage = <1800000>;
};

&pm8941_l11 {
	regulator-min-microvolt = <1300000>;
	regulator-max-microvolt = <1300000>;
	qcom,init-voltage = <1300000>;
};

&pm8941_l17 {
	regulator-min-microvolt = <2800000>;
	regulator-max-microvolt = <2800000>;
	qcom,init-voltage = <2800000>;
};

&pm8941_l23 {
	regulator-min-microvolt = <2800000>;
	regulator-max-microvolt = <2800000>;
	qcom,init-voltage = <2800000>;
};
