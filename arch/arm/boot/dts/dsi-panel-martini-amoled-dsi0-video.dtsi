/* Copyright (c) 2017, The Linux Foundation. All rights reserved.
 *
 * This program is free software; you can redistribute it and/or modify
 * it under the terms of the GNU General Public License version 2 and
 * only version 2 as published by the Free Software Foundation.
 *
 * This program is distributed in the hope that it will be useful,
 * but WITHOUT ANY WARRANTY; without even the implied warranty of
 * MERCHANTABILITY or FITNESS FOR A PARTICULAR PURPOSE.  See the
 * GNU General Public License for more details.
 */

/*
 * Lumia 930 panel parameters from the working Martini kernel.
 * Use the legacy MDSS bindings implemented by this kernel.
 */

&soc {
	dsi_martini_amoled_dsi0_video: qcom,mdss_dsi_martini_amoled_dsi0_video {
		compatible = "qcom,mdss-dsi-panel";
		label = "Martini 1080p AMOLED video panel";
		qcom,dsi-ctrl-phandle = <&mdss_dsi0>;
		qcom,rst-gpio = <&pm8941_gpios 19 0>;
		qcom,mdss-dsi-reset-sequence = <1 20>, <0 200>, <1 20>;
		/*
		 * The low 16 MiB, including UEFI's framebuffer, is kept out of
		 * Linux RAM. Preserve the active display until the splash finish
		 * path stops its timing engine before attaching the MDP IOMMU.
		 */
		qcom,cont-splash-enabled;

		qcom,mdss-pan-res = <1080 1920>;
		qcom,mdss-pan-bpp = <24>;
		qcom,mdss-pan-width = <65>;
		qcom,mdss-pan-height = <115>;
		qcom,mdss-pan-dest = "display_1";
		qcom,mdss-pan-porch-values = <30 20 46 2 1 13>;
		qcom,mdss-pan-underflow-clr = <0xff>;
		qcom,mdss-pan-bl-ctrl = "bl_ctrl_dcs";
		qcom,mdss-pan-bl-levels = <1 128>;
		qcom,mdss-pan-dsi-mode = <0>;
		qcom,mdss-pan-dsi-h-pulse-mode = <1>;
		qcom,mdss-pan-dsi-h-power-stop = <0 0 0>;
		qcom,mdss-pan-dsi-bllp-power-stop = <1 1>;
		qcom,mdss-pan-dsi-traffic-mode = <2>;
		qcom,mdss-pan-dsi-dst-format = <3>;
		qcom,mdss-pan-dsi-vc = <0>;
		qcom,mdss-pan-dsi-rgb-swap = <0>;
		qcom,mdss-pan-dsi-data-lanes = <1 1 1 1>;
		qcom,mdss-pan-dsi-dlane-swap = <0>;
		qcom,mdss-pan-dsi-t-clk = <0x36 0x00>;
		qcom,mdss-pan-dsi-stream = <0>;
		qcom,mdss-pan-dsi-mdp-tr = <0>;
		qcom,mdss-pan-dsi-dma-tr = <4>;
		qcom,mdss-pan-dsi-frame-rate = <60>;

		/* PHY settings from the reference kernel's DSI0 controller. */
		qcom,panel-phy-regulatorSettings = [07 09 03 00 20 00 01];
		qcom,panel-phy-timingSettings = [d5 9a 1e 00 66 5e 36 9e 55 03 04 00];
		qcom,panel-phy-strengthCtrl = [ff 06];
		qcom,panel-phy-bistCtrl = [00 00 b1 ff 00 00];
		qcom,panel-phy-laneConfig = [00 00 00 00 00 00 00 01 97
			00 00 00 00 00 00 00 01 97
			00 00 00 00 00 00 00 01 97
			00 00 00 00 00 00 00 01 97
			00 c0 00 00 00 00 00 01 bb];

		qcom,panel-on-cmds = [
			05 01 00 00 78 00 02 11 00
			39 01 00 00 00 00 03 F0 5A 5A
			39 01 00 00 00 00 0E CB 16 00 01 01 DE 01 00 00 03 00 06 00 08
			39 01 00 00 00 00 02 F7 03
			39 01 00 00 65 00 03 F0 A5 A5
			15 01 00 00 00 00 02 53 2C
			15 01 00 00 00 00 02 51 FF
			05 01 00 00 00 00 02 29 00
		];
		qcom,on-cmds-dsi-state = "DSI_LP_MODE";
		qcom,panel-off-cmds = [
			05 01 00 00 00 00 02 28 00
			15 01 00 00 00 00 02 53 00
			05 01 00 00 78 00 02 10 00
		];
		qcom,off-cmds-dsi-state = "DSI_HS_MODE";
	};
};
